/**
 * @cliArgs --board "/ti/boards/MSP_EXP432P401R" --product "simplelink_msp432p4_sdk@3.40.01.02"
 * @versions {"data":"2020052512","timestamp":"2020052512","tool":"1.5.0+1397","templates":"2020052512"}
 */

/**
 * Import the modules used in this configuration.
 */
const Display  = scripting.addModule("/ti/display/Display", {}, false);
const Display1 = Display.addInstance();
const ADC      = scripting.addModule("/ti/drivers/ADC", {}, false);
const ADC1     = ADC.addInstance();
const GPIO     = scripting.addModule("/ti/drivers/GPIO", {}, false);
const GPIO1    = GPIO.addInstance();
const GPIO2    = GPIO.addInstance();
const GPIO3    = GPIO.addInstance();
const GPIO4    = GPIO.addInstance();
const GPIO5    = GPIO.addInstance();
const GPIO6    = GPIO.addInstance();
const GPIO7    = GPIO.addInstance();
const GPIO8    = GPIO.addInstance();
const GPIO9    = GPIO.addInstance();
const PWM      = scripting.addModule("/ti/drivers/PWM", {}, false);
const PWM1     = PWM.addInstance();
const PWM2     = PWM.addInstance();
const Power    = scripting.addModule("/ti/drivers/Power");
const RTOS     = scripting.addModule("/ti/drivers/RTOS");
const UART     = scripting.addModule("/ti/drivers/UART", {}, false);
const UART2    = UART.addInstance();
const Button   = scripting.addModule("/ti/drivers/apps/Button", {}, false);
const Button1  = Button.addInstance();
const Button2  = Button.addInstance();

/**
 * Write custom configuration values to the imported modules.
 */
Display1.$name      = "CONFIG_Display_0";
Display1.uart.$name = "CONFIG_UART_0";

ADC1.$name      = "CONFIG_ADC_0";
ADC1.resolution = "8 Bits";

GPIO1.mode            = "Output";
GPIO1.$name           = "CONFIG_GPIO_AIN1";
GPIO1.gpioPin.$assign = "boosterpack.12";

GPIO2.mode            = "Output";
GPIO2.$name           = "CONFIG_GPIO_AIN2";
GPIO2.gpioPin.$assign = "boosterpack.11";

GPIO3.callbackFunction = "Encoder_Callback";
GPIO3.interruptTrigger = "High";
GPIO3.$name            = "CONFIG_GPIO_ENCODER";

GPIO4.$name              = "CONFIG_GPIO_3";
GPIO4.$hardware          = system.deviceData.board.components.LED1_RED;
GPIO4.initialOutputState = "High";

GPIO5.$name           = "CONFIG_GPIO_SI";
GPIO5.mode            = "Output";
GPIO5.gpioPin.$assign = "boosterpack.29";

GPIO6.$name           = "CONFIG_GPIO_CLK";
GPIO6.mode            = "Output";
GPIO6.gpioPin.$assign = "boosterpack.28";

GPIO7.$name            = "CONFIG_GPIO_SDA";
GPIO7.callbackFunction = "";
GPIO7.mode             = "Dynamic";
GPIO7.gpioPin.$assign  = "boosterpack.15";

GPIO8.$name            = "CONFIG_GPIO_SCL";
GPIO8.callbackFunction = "";
GPIO8.mode             = "Dynamic";
GPIO8.gpioPin.$assign  = "boosterpack.14";

GPIO9.$name           = "CONFIG_GPIO_BUZZER";
GPIO9.mode            = "Output";
GPIO9.gpioPin.$assign = "boosterpack.8";

PWM1.$name                = "CONFIG_PWM_MOTOR";
PWM1.timer.$assign        = "Timer_A0";
PWM1.timer.pwmPin.$assign = "boosterpack.34";

PWM2.$name                = "CONFIG_PWM_SERVO";
PWM2.timer.$assign        = "Timer_A1";
PWM2.timer.pwmPin.$assign = "boosterpack.40";

Power.initialPerformanceLevel = 3;
Power.performanceLevel3.$name = "ti_drivers_power_PowerMSP432PerfLevels0";
Power.performanceLevel2.$name = "ti_drivers_power_PowerMSP432PerfLevels1";
Power.performanceLevel1.$name = "ti_drivers_power_PowerMSP432PerfLevels2";
Power.performanceLevel0.$name = "ti_drivers_power_PowerMSP432PerfLevels3";

RTOS.name = "FreeRTOS";

UART2.$name     = "CONFIG_UART_NO_NEWLINE";
UART2.$hardware = system.deviceData.board.components.XDS110UART;

Button1.$name         = "CONFIG_BUTTON_MODE";
Button1.$hardware     = system.deviceData.board.components.S1;
Button1.gpioPin.$name = "CONFIG_GPIO_0";

Button2.$name         = "CONFIG_BUTTON_VALUE";
Button2.$hardware     = system.deviceData.board.components.S2;
Button2.gpioPin.$name = "CONFIG_GPIO_1";

/**
 * Pinmux solution for unlocked pins/peripherals. This ensures that minor changes to the automatic solver in a future
 * version of the tool will not impact the pinmux you originally saw.  These lines can be completely deleted in order to
 * re-solve from scratch.
 */
Display1.uart.uart.$suggestSolution       = "EUSCI_A1";
Display1.uart.uart.txPin.$suggestSolution = "boosterpack.19";
Display1.uart.uart.rxPin.$suggestSolution = "boosterpack.38";
ADC1.adc.$suggestSolution                 = "ADC14";
ADC1.adc.adcPin.$suggestSolution          = "boosterpack.30";
GPIO3.gpioPin.$suggestSolution            = "boosterpack.7";
GPIO4.gpioPin.$suggestSolution            = "P1.0.GPIO/EUSCI_A0_SPI.STE";
UART2.uart.$suggestSolution               = "EUSCI_A0";
UART2.uart.txPin.$suggestSolution         = "P1.3.GPIO/EUSCI_A0_UART.TXD/EUSCI_A0_SPI.SIMO";
UART2.uart.rxPin.$suggestSolution         = "P1.2.GPIO/EUSCI_A0_UART.RXD/EUSCI_A0_SPI.SOMI";
Button1.gpioPin.gpioPin.$suggestSolution  = "P1.1.GPIO/EUSCI_A0_SPI.CLK";
Button2.gpioPin.gpioPin.$suggestSolution  = "P1.4.GPIO/EUSCI_B0_SPI.STE";
